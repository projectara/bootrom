## apps/secondstage/MIRACL_cfg/defconfig
```kconfig
# libmcl build configuration

# Output build directory
OUTBUILD := $(MIRACL_OUTROOT)

# Output directory
OUTBIN := $(MIRACL_OUTROOT)/lib

# Tool chain
CROSS_COMPILE = arm-none-eabi-

# Specific architecture
ARCH_FLAGS=-mcpu=cortex-m3 -mthumb

# Turn on/off ARM cross compile
#CONFIG_ARM=n
CONFIG_ARM=y

# Turn on/off Testing
#CONFIG_TEST=y
CONFIG_TEST=n

# Turn on/off function decoration
#CONFIG_DECORATOR=y
CONFIG_DECORATOR=n

# Marvell board SDK
AWS_SDK=

# Number of iterations to run benchmark tests
ITERATIONS=10
```

## chips/es1tsb/defconfig
```kconfig
include $(TOPDIR)/chips/tsb/defconfig

CONFIG_DEBUG=y
CONFIG_CHIP_REVISION=0x01
CONFIG_BOOT_FROM_SLOW_ROM=y
```

## chips/es1tsb_rom/defconfig
```kconfig
include $(TOPDIR)/chips/tsb/defconfig

CONFIG_DEBUG=y
CONFIG_BOOT_RUNFROMROM=y
CONFIG_BOOT_RUNFROMISRAM=
```

## chips/es2tsb/defconfig
```kconfig
include $(TOPDIR)/chips/tsb/defconfig

CONFIG_DEBUG=y
CONFIG_CHIP_REVISION=0x02
CONFIG_BOOT_FROM_SLOW_ROM=y
CONFIG_ARCH_EXTRA=es2tsb
UNIPRO_ACTIVE=y
```

## chips/es3tsb/defconfig
```kconfig
include $(TOPDIR)/chips/tsb/defconfig

CONFIG_DEBUG=
CONFIG_ARCH_EXTRA=es3tsb
UNIPRO_ACTIVE=y
```

## chips/fpgatsb/defconfig
```kconfig
include $(TOPDIR)/chips/tsb/defconfig
include $(TOPDIR)/chips/es3tsb/defconfig

CONFIG_DEBUG=y
CONFIG_UART_CLOCK_DIVIDER=13
```

## chips/tsb/defconfig
```kconfig
#
# bootrom/ Configuration
#

#
# Build Setup
#
# CONFIG_EXPERIMENTAL is not set
CONFIG_DEFAULT_SMALL=y
CONFIG_HOST_LINUX=y

#
# Binary Output Formats
#
CONFIG_RAW_BINARY=y

#
# Debug Options
#
# CONFIG_DEBUG is not set

#
# chip Options
#
CONFIG_ARCH_CHIP="tsb"
# chip revision:
#   higher 4bits are production chip revision, so it is 0 for all ESx.
#   lower 4bits are minor revisions, here is stands for the x in ESx
CONFIG_CHIP_REVISION=0x03
#
# Boot options
#
#
# UART Configuration
#
CONFIG_UART_BAUD=115200
CONFIG_UART_CLOCK_DIVIDER=26

#
# GPIO Configuration
#
# CONFIG_GPIO is not set

#
# Crypto API
#
# CONFIG_CRYPTO is not set

#
# Greybus utility
#
# CONFIG_GREYBUS_DEBUG is not set
# CONFIG_MANIFEST_BOOT is not set
```

## common/vendors/MIRACL/ara/defconfig
```kconfig
# libmcl build configuration

# Output build directory
OUTBUILD := build

# Output directory
OUTBIN := bin

# Tool chain
CROSS_COMPILE = arm-none-eabi-

# Specific architecture
ARCH_FLAGS=-mthumb -mcpu=cortex-m4

# Turn on/off ARM cross compile
CONFIG_ARM=n
#CONFIG_ARM=y

# Turn on/off Testing
CONFIG_TEST=y
#CONFIG_TEST=n

# Turn on/off function decoration
#CONFIG_DECORATOR=y
CONFIG_DECORATOR=n

# Marvell board SDK
AWS_SDK=/home/kealan/cert_proj/ara/board/aws_starter_sdk/

# Number of iterations to run benchmark tests
ITERATIONS=10
```
